//#######################################################################################################
//#################################### Plugin 198: THPLightSensor
//####################################
//#######################################################################################################
#define _Digole_Serial_I2C_ // To tell compiler compile the special

#include "DigoleSerial.h"
#include <stdio.h>
/* Useful Constants */
#define MSEC_PER_SEC (1000UL)
#define MSECS_PER_MIN (60000UL)
#define MSEC_PER_HOUR (3600000UL)

#define INFO_LINES 3
#define INFO_LENGTH 40
/* Useful Macros for getting elapsed time */
#define numberOfHours(_time_) (_time_ / MSEC_PER_HOUR)
#define numberOfMinutes(_time_) ((_time_ % MSEC_PER_HOUR) / MSECS_PER_MIN)
#define numberOfSeconds(_time_)                                                \
  (((_time_ % MSEC_PER_HOUR) % MSECS_PER_MIN) / MSEC_PER_SEC)

// communication only,
// all available are:_Digole_Serial_UART_, _Digole_Serial_I2C_ and

char buf[50];

//--------I2C setup
#if defined(_Digole_Serial_I2C_)
//#include <Wire.h>
DigoleSerialDisp mydisp(&Wire, '\x27');
#endif

#define PLUGIN_198
#define PLUGIN_ID_198 198
#define PLUGIN_NAME_198 "THP Light Sensor"
#define PLUGIN_VALUENAME1_198 "Lux"
#define PLUGIN_VALUENAME2_198 "Avg"
#define PLUGIN_VALUENAME3_198 "Color"
#define PLUGIN_VALUENAME4_198 "Update ms"

#define BH1750_ADDRESS_1 0x23
#define BH1750_ADDRESS_2 0x5c
boolean blnPlugin_198_init1 = false;
boolean blnPlugin_198_init2 = false;
boolean blnPlugin_198_init3_time = false;
boolean blnPlugin_198_init4_onlyOnce = true;

const unsigned char fonts[] = {6, 10, 18, 51, 120, 123};
const char *fontdir[] = {"0\xb0", "90\xb0", "180\xb0", "270\xb0"};
static long max = 0;
static long avg = 0;
static long sum = 0;
long mqtt_send_every_ms;
long count = 1;
long secs = 1;

static const unsigned char PROGMEM endimage[] = {

    B11111111, B11111111, B11111111, B11111111, B11111111, B11111111, B11111111,
    B11111111, B11111111, B11111111, B11111111, B11111111, B11111111, B11111111,
    B11111111, B11111111, B11111111, B11111111, B11111111, B11111111, B11111111,
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    B11111111, B11111111};

static const unsigned char PROGMEM welcomeimage[] = {

    B00000000, B00000000, B00000000, B00000000, B00000000, B00000000, B00000000,
    B00000000, B00000000, B00000000, B00000000, B00000000, B00000000, B00000000,
    B00000000, B00000000, B00000000, B00000000, B00000000, B00000000, B00000000,
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    B00000000, B00000000};

boolean Plugin_198(byte function, struct EventStruct *event, String &string) {
  boolean success = false;
  static byte displayTimer = 0;

  switch (function) {

  case PLUGIN_DEVICE_ADD: {
    Device[++deviceCount].Number = PLUGIN_ID_198;
    Device[deviceCount].Type = DEVICE_TYPE_I2C;
    Device[deviceCount].VType = SENSOR_TYPE_QUAD;
    Device[deviceCount].Ports = 0;
    Device[deviceCount].PullUpOption = false;
    Device[deviceCount].InverseLogicOption = false;
    Device[deviceCount].FormulaOption = false;
    Device[deviceCount].DecimalsOnly = false;
    Device[deviceCount].ValueCount = 3;
    Device[deviceCount].SendDataOption = true;
    Device[deviceCount].TimerOption = true;
    Device[deviceCount].GlobalSyncOption = true;
    break;
  }

  case PLUGIN_GET_DEVICENAME: {
    string = F(PLUGIN_NAME_198);
    break;
  }

  case PLUGIN_GET_DEVICEVALUENAMES: {
    /* MQTT delay ms */
    strcpy_P(ExtraTaskSettings.TaskDeviceValueNames[0],
             PSTR(PLUGIN_VALUENAME1_198));

    // Avg
    strcpy_P(ExtraTaskSettings.TaskDeviceValueNames[1],
             PSTR(PLUGIN_VALUENAME2_198));
    // UpdateMQTT
    strcpy_P(ExtraTaskSettings.TaskDeviceValueNames[3],
             PSTR(PLUGIN_VALUENAME3_198));
    // color
    strcpy_P(ExtraTaskSettings.TaskDeviceValueNames[2],
             PSTR(PLUGIN_VALUENAME4_198));
    break;
  }

  case PLUGIN_WEBFORM_LOAD: {
    //------------- Measure time -------------------------
    byte choice = Settings.TaskDevicePluginConfig[event->TaskIndex][0];
    String options[6];
    options[0] = F("180min");
    options[1] = F("60min - default");
    options[2] = F("30min");
    options[3] = F("15min");
    options[4] = F("10min");
    options[5] = F("5min");
    int optionValues[6];
    optionValues[1] = 60;
    optionValues[2] = 30;
    optionValues[3] = 15;
    optionValues[4] = 10;
    optionValues[5] = 5;
    optionValues[0] = 180;
    string +=
        F("<TR><TD>Measure time:<TD><select name='plugin_198_measuretime'>");
    for (byte x = 0; x < 6; x++) {
      string += F("<option value='");
      string += optionValues[x];
      string += "'";
      if (choice == optionValues[x])
        string += F(" selected");
      string += ">";
      string += options[x];
      string += F("</option>");
    }
    string += F("</select>");

    //------------- update time -------------------------
    byte choice1 = Settings.TaskDevicePluginConfig[event->TaskIndex][1];
    String options2[2];
    options2[0] = F("0x23 - default settings (ADDR Low)");
    options2[1] = F("0x5c - alternate settings (ADDR High)");
    int optionValues2[2];
    optionValues2[0] = 0;
    optionValues2[1] = 1;
    string += F("<TR><TD>BH1750 Address:<TD><select name='plugin_198_bh1750'>");
    for (byte x = 0; x < 2; x++) {
      string += F("<option value='");
      string += optionValues2[x];
      string += "'";
      if (choice1 == optionValues2[x])
        string += F(" selected");
      string += ">";
      string += options2[x];
      string += F("</option>");
    }
    string += F("</select>");

    byte choice2 = Settings.TaskDevicePluginConfig[event->TaskIndex][2];
    String options3[7];
    options3[0] = F("WHITE - default");
    options3[1] = F("GREEN");
    options3[2] = F("ORANGE");
    options3[3] = F("RED");
    options3[4] = F("BLUE");
    options3[5] = F("CYAN");
    options3[6] = F("VIOLETT");

    int optionValues3[7];
    optionValues3[0] = 0;
    optionValues3[1] = 1;
    optionValues3[2] = 2;
    optionValues3[3] = 3;
    optionValues3[4] = 4;
    optionValues3[5] = 5;
    optionValues3[6] = 6;
    string += F("<TR><TD>Choose color:<TD><select name='plugin_198_color'>");
    for (byte x = 0; x < 7; x++) {
      string += F("<option value='");
      string += optionValues3[x];
      string += "'";
      if (choice2 == optionValues3[x])
        string += F(" selected");
      string += ">";
      string += options3[x];
      string += F("</option>");
    }
    string += F("</select>");

    char infoText[INFO_LINES][INFO_LENGTH];
    LoadCustomTaskSettings(event->TaskIndex, (byte *)&infoText,
                           sizeof(infoText));
    for (byte varNr = 0; varNr < INFO_LINES; varNr++) {
      string += F("<TR><TD>Line ");
      string += varNr + 1;
      string += F(":<TD><input type='text' size='40' maxlength='40' "
                  "name='Plugin_198_infotext");
      string += varNr + 1;
      string += F("' value='");
      string += infoText[varNr];
      string += F("'>");
    }
    success = true;
    break;
  }

  case PLUGIN_WEBFORM_SAVE: {
    String plugin1 = WebServer.arg("plugin_198_measuretime");
    Settings.TaskDevicePluginConfig[event->TaskIndex][0] = plugin1.toInt();
    String plugin2 = WebServer.arg("plugin_198_bh1750");
    Settings.TaskDevicePluginConfig[event->TaskIndex][1] = plugin2.toInt();
    String plugin3 = WebServer.arg("plugin_198_color");
    Settings.TaskDevicePluginConfig[event->TaskIndex][2] = plugin3.toInt();
    char infoText[INFO_LINES][INFO_LENGTH];
    for (byte varNr = 0; varNr < INFO_LINES; varNr++) {
      char argc[25];
      String arg = F("Plugin_198_infotext");
      arg += varNr + 1;
      arg.toCharArray(argc, 25);
      String tmpString = WebServer.arg(argc);
      strncpy(infoText[varNr], tmpString.c_str(), sizeof(infoText[varNr]));
    }
    Settings.TaskDeviceID[event->TaskIndex] =
        1; // temp fix, needs a dummy value

    SaveCustomTaskSettings(event->TaskIndex, (byte *)&infoText,
                           sizeof(infoText));
    success = true;
    break;
  }

  case PLUGIN_READ: {
    /** measurement time **/
    byte mtime = Settings.TaskDevicePluginConfig[event->TaskIndex][0];
    String log = F("Measure time: ");
    log = String(mtime, DEC);
    log += F("min| ");
    if (secs >= (mtime * 60)) {
      Plugin_198_setEndScreen();
      break;
    }

    /** color **/
    String options3[7];
    options3[0] = F("WHITE - default");
    options3[1] = F("GREEN");
    options3[2] = F("ORANGE");
    options3[3] = F("RED");
    options3[4] = F("BLUE");
    options3[5] = F("CYAN");
    options3[6] = F("VIOLETT");
    byte color = Settings.TaskDevicePluginConfig[event->TaskIndex][2];

    // --- I2C BH1750
    uint8_t address = -1;
    boolean *Plugin_198_init;

    if (Settings.TaskDevicePluginConfig[event->TaskIndex][1] == 0) {
      address = BH1750_ADDRESS_1;
      Plugin_198_init = &blnPlugin_198_init1;
    } else {
      address = BH1750_ADDRESS_2;
      Plugin_198_init = &blnPlugin_198_init2;
    }

    if (!*Plugin_198_init) {
      *Plugin_198_init = Plugin_198_setResolution(address);
    }

    if (Wire.requestFrom(address, (uint8_t)2) == 2) {
      byte b1 = Wire.read();
      byte b2 = Wire.read();
      float val = 0xffff;             // pm-cz: Maximum obtainable value
      if (b1 != 0xff || b2 != 0xff) { // pm-cz: Add maximum range check
        val = ((b1 << 8) | b2) / 1.2;
      }
      /** data format **/
      /** 0       1             2                 3
      /** value, milliseconds, measurement-time, color **/

      /** send data only to broker if update time is reached **/
      UserVar[event->BaseVarIndex] = val;
      UserVar[event->BaseVarIndex + 1] = avg;
      UserVar[event->BaseVarIndex + 2] = color;
      UserVar[event->BaseVarIndex + 3] = mtime;

      Plugin_198_UpdateLux((unsigned long)val);

      log += F("Lux (");
      log += UserVar[event->BaseVarIndex];
      log += F(")| Avg(");
      log += (long)UserVar[event->BaseVarIndex + 1];
      log += F(")| Color(");
      log += String(color, DEC);
      log += F("/");
      log += options3[color];
      log += F(")| IP(");
      log += WiFi.localIP().toString();
      log += F(")");
      addLog(LOG_LEVEL_INFO, log);
      // mydisp.setFont(fonts[3]);

      success = true;
    }
    break;
  }
  case PLUGIN_INIT: {
    mydisp.setPrintPos(0, 0, _TEXT_);
    delay(3000); // delay x seconds
    /*----------for text LCD adapter and graphic LCD adapter ------------*/
    mydisp.setColor(1);
    mydisp.clearScreen(); // CLear screen
    mydisp.disableCursor();
    mydisp.drawBitmap(0, 0, 128, 64, welcomeimage);
    delay(2000);
    mydisp.clearScreen();
    mydisp.drawStr(0, 1, "calibrating...");
    mydisp.drawStr(0, 2, "please wait");
    WiFi.localIP().toString().toCharArray(buf, 20);
    mydisp.drawStr(0, 3, buf);

    mydisp.begin();
    break;
  }

  case PLUGIN_ONCE_A_SECOND: {
    byte mtime = Settings.TaskDevicePluginConfig[event->TaskIndex][0];
    if (secs < (UserVar[event->BaseVarIndex + 3] * 60)) {
      if (blnPlugin_198_init4_onlyOnce && blnPlugin_198_init3_time) {
        Plugin_198_UpdateColor(UserVar[event->BaseVarIndex + 3]);
        blnPlugin_198_init4_onlyOnce = false;
      }
      if (blnPlugin_198_init3_time) {
        Plugin_198_UpdateScreenTime(mtime);
      }
    } else {
      blnPlugin_198_init3_time = false;
    }
  }
  // update screen time

  break;
  }
  return success;
}

void Plugin_198_UpdateLux(unsigned long lux) {
  const byte x = 0;
  const byte y = 0;
  const byte w = 128;
  const byte h = 30;
  if (!blnPlugin_198_init3_time) {
    mydisp.clearScreen();
    blnPlugin_198_init3_time = true;
  }
  sprintf(buf, "%05lu", lux);
  mydisp.disableCursor();
  // mydisp.setMode('^'); // XOR mode
  mydisp.setColor(0);
  mydisp.drawBox(x, y, w, h);
  mydisp.setFont(fonts[3]);
  mydisp.setColor(1);
  mydisp.setTextPosAbs(x + 5, y + 20);
  mydisp.print(buf);
  /*-- static text --*/
  mydisp.setFont(fonts[1]);
  mydisp.setTextPosAbs(80, y + 20);
  mydisp.print("lx");

  Plugin_198_LuxValues(x, y, w, h, lux);
}

void Plugin_198_LuxValues(uint8_t x, uint8_t y, uint8_t w, uint8_t h,
                          unsigned long lux) {

  if (lux > max) {
    max = lux;
  }
  sum += lux;
  avg = sum / count;
  count++;

  mydisp.setColor(1);
  mydisp.setFont(fonts[1]);
  sprintf(buf, "(M:%5lu|A:%5lu)lx", max, avg);
  mydisp.setTextPosAbs(1, y + h + 3);
  mydisp.print(buf);
}

void Plugin_198_UpdateColor(uint8_t color) {
  String options3[7];
  char b[10];
  options3[0] = F("WHITE");
  options3[1] = F("GREEN");
  options3[2] = F("ORANGE");
  options3[3] = F("RED");
  options3[4] = F("BLUE");
  options3[5] = F("CYAN");
  options3[6] = F("VIOLETT");
  if (color < sizeof(options3)) {
    options3[color].toCharArray(b, 10);
  } else {
    sprintf(b, "err");
  }
  sprintf(buf, "Color:%s", b);
  mydisp.setColor(1);
  mydisp.setFont(fonts[1]);
  mydisp.setTextPosAbs(0, 50);
  mydisp.print(buf);
}

/**
  Update elapsed time and running time

**/
void Plugin_198_UpdateScreenTime(byte minutes) {
  long t = millis();
  uint8_t h = (uint8_t)numberOfHours(t);
  uint8_t m = (uint8_t)numberOfMinutes(t);
  uint8_t s = (uint8_t)numberOfSeconds(t);
  sprintf(buf, "%02d:%02d:%02d", h, m, s);
  mydisp.setColor(1); // white
  // mydisp.drawBox(60, 50, 68, 14);
  // mydisp.setColor(0);
  mydisp.setFont(fonts[1]);
  // mydisp.setMode('~');
  mydisp.setColor(1);
  mydisp.setTextPosAbs(70, 62);
  mydisp.print(buf);

  if (minutes == 0)
    minutes = 60;
  long elapsed = minutes * 60; // in seconds
  elapsed -= ++secs;
  if (elapsed < 0)
    elapsed = 0;
  sprintf(buf, "R:%5lusec", elapsed);
  mydisp.setTextPosAbs(1, 62);
  mydisp.print(buf);
}

void Plugin_198_setEndScreen() {
  if (!blnPlugin_198_init4_onlyOnce) {
    /*----------for text LCD adapter and graphic LCD adapter ------------*/
    mydisp.setColor(1);
    mydisp.clearScreen(); // CLear screen
    mydisp.disableCursor();
    mydisp.drawBitmap(0, 0, 128, 64, endimage);
    secs = 99999;
  }
  blnPlugin_198_init4_onlyOnce = true;
}

boolean Plugin_198_setResolution(uint8_t address) {
  Wire.beginTransmission(address);
  Wire.write(0x10); // 1 lx resolution
  Wire.endTransmission();
  return true;
}
